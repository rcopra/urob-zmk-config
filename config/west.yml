## config/west.yml
```yaml
manifest:
  remotes:
    - name: zmkfirmware
      url-base: https://github.com/zmkfirmware
    - name: urob
      url-base: https://github.com/urob
    - name: temper
      url-base: https://github.com/raeedcho

  projects:
    - name: zmk
      remote: urob
      revision: main
      import: app/west.yml
    - name: zmk-helpers
      remote: urob
      revision: v2
    - name: temper-zmk-config
      remote: temper
      revision: main
      import: west.yml

  self:
    path: config
```
